#include "splc501.h"
#include "mcu_uart.h"

void delay()
{
	_nop_();_nop_();_nop_();_nop_();_nop_();
}

code unsigned char lv[]={
        0x00,0x00,0x00,0x00,0x00,0x00,0x00,0x00,0x00,0x00,0x00,0x00, // - -
        0x00,0x00,0x00,0x7C,0x00,0x00,0x00,0x00,0x00,0x80,0x00,0x00, // -!-
        0x00,0x70,0x40,0x00,0x70,0x40,0x00,0x00,0x00,0x00,0x00,0x00, // -"-
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        0x00,0x00,0x00,0x00,0x00,0x00,0x00,0x00,0x00,0x00,0x00,0x00, // --
}; 
idata char *q=lv;

//========================================================
/*void LCD_CheckBusy(void)
{
   //DataPort=0xff;
	LCD_IO_DATA=0xff;
   RS=0;  
   //_nop_();
   RW=1; 
   _nop_();
   EN=1;
   _nop_();
   _nop_();
   //while(DataPort&Busy);
	DDRC=0x00;
	while(PINC&Busy);
   EN=0;
}*/
//========================================================
/*void LCD_Enable(void)
{
   EN=1;
   _nop_();_nop_();_nop_();
   _nop_();
   EN=0;
}*/
//========================================================
//void LCD_WriteCommand(void)
/*void sendorder(void)
{     
   //LCD_CheckBusy();
   RS=0; _nop_();_nop_();_nop_();_nop_();
   //_nop_();
   RW=0;     
   _nop_();_nop_();_nop_();
   //DataPort=Command;
   _nop_();
   LCD_Enable();
   //RW=1;   
   //_nop_();
   //RS=0;  
   //_nop_();
}*/
//========================================================
//void LCD_WriteData(void)
/*void senddata(void)
{
   //LCD_CheckBusy();
   RS=1;  
   //_nop_();
   RW=0;     
   _nop_();
   //DataPort=Data;
   _nop_();
   LCD_Enable();
   //RW=1;
   //_nop_();
   //RS=0; 
   //_nop_();
}*/
//========================================================
//========================================================
//初始化LCD
//========================================================
void InitGraphic(void)
{
		//========================================================
		LCD_IO_DATA =0x00;                  //端口初始化
		LCD_IO_CONTROL =0x8f;
		//========================================================
		
		LCD_IO_CONTROL &= ~C_RST_Pin;
		LCD_IO_CONTROL |= C_RST_Pin;
		
		//========================================================
		LCD_IO_DATA =0xaf;	//LCD_ON								  
		sendorder();
		LCD_IO_DATA =0x2f;	//上电模式
		sendorder();
		LCD_IO_DATA =0x81;	//电量设置模式(屏幕亮度)
		sendorder();
		LCD_IO_DATA =0x30;	//指令数据
		sendorder();
		LCD_IO_DATA =0x27;	//内部电压调节电阻设置
		sendorder();
		LCD_IO_DATA =0xa3;	//偏压设置
		sendorder();
		LCD_IO_DATA =0xc0;	//Com 扫描方式设置(0xc8反向)
		sendorder();
		//LCD_IO_DATA =0xa1;
		LCD_IO_DATA =0xa0;  //Segment方向选择(0xa1反向)
		sendorder();
		LCD_IO_DATA =0xa4;  //全屏变亮(0xa5变亮)
		sendorder();
		LCD_IO_DATA =0xa6;  //正相反相显示控制指令，RAM中数据不变(0xa7)
		sendorder();
		LCD_IO_DATA =0xac;  //静态指示器控制指令(0xad为on)
		sendorder();
		LCD_IO_DATA =0x00;  
		sendorder();
		LCD_IO_DATA =0x40;  //设置显示起始行对应RAM行号
		sendorder();
		//setpage(0);
		//setaddr(0);
		ClearScreen(0);
}

 /*LCD_IO_DATA =0xe2;                  //复位 reset
 sendorder();                              //送命令子函数
 LCD_IO_DATA =0xe3;                  //空操作 
 sendorder();
 LCD_IO_DATA =0xc0;                  //COM口扫描方向63---0
  sendorder();
 LCD_IO_DATA =0xa0;                  //ADC(segment方向)设定为正常  A1  reverse
  sendorder();
 //电源设定
 //========================================================
 LCD_IO_DATA =0xa2;                  // LCD偏压设定 1/9 bias
  sendorder();
 LCD_IO_DATA =0x24;                  //V5电压内部电阻调整设置 
  sendorder();
 LCD_IO_DATA =0x81;                  //电量设置模式 （双字节）
  sendorder();                                
 LCD_IO_DATA =0x1a;                  //调整显示屏亮度
  sendorder();
 LCD_IO_DATA =0xd2;                  //驱动模式
  sendorder();
 LCD_IO_DATA =0x00;                  //模式2
 sendorder();
 LCD_IO_DATA =0x2c;                  //上电控制设置   REGULATOR on
 sendorder();
 LCD_IO_DATA =0x2e; //while(1)              //上电控制设置   +FOLLOWER oFF  ????（或许是）
 sendorder();
 LCD_IO_DATA =0x2f;                 //上电控制设置   +FOLLOWER on   ????（或许是）
 sendorder();                              //power set  over
  //========================================================
 LCD_IO_DATA =0xaf;                  //开显示
 sendorder();
 setpage(0);                                //页设置为第0页 
 LCD_IO_DATA =0x40;                  //显示起始行设置为第0行 
 sendorder();
 setaddr(0);                                //列设置为第0列

 LCD_IO_DATA =0xa5;                  //全屏点亮
 
 sendorder();
 LCD_IO_DATA =0xa4;                  //正常显示
 sendorder(); 
 ClearScreen(0);                           //清屏全部ROM填零
}*/                               
//========================================================
//初始化LCD结束

//发送命令子函数
//========================================================
void sendorder(void)
{
		idata char c;
		c=(C_AOP_Pin|C_EP_Pin|C_RWP_Pin);
		c^=0xff;
		LCD_IO_CONTROL=c;
		delay();
		LCD_IO_CONTROL=c|C_EP_Pin;
		delay();
		LCD_IO_CONTROL=c;		 
		delay();
}
//========================================================
//写入数据子函数
//========================================================
void senddata(void)
{
		idata char c;
		c=(C_AOP_Pin|C_EP_Pin|C_RWP_Pin);
		c^=0xff;
		LCD_IO_CONTROL=c;
		delay();
		LCD_IO_CONTROL=c|C_AOP_Pin|C_EP_Pin;
		delay();
		LCD_IO_CONTROL=c;
		delay();
}
//========================================================
//页设置子函数
//========================================================
void setpage( int a)
{
		a|=0xb0;; //a|=0xb0;
		LCD_IO_DATA =a;
		sendorder();
}
//========================================================
//列设置子函数
//========================================================
void setaddr( int addr)
{
		idata int b;
		b=addr>>4;
		b&=0x1f;
		b|=0x10;
		addr&=0x0f;
		LCD_IO_DATA =addr;
		sendorder();
		LCD_IO_DATA =b;
		sendorder();
 }
//========================================================
//清屏子函数     fill ROM with 0 or 1
//========================================================
void ClearScreen( int a)
{
		idata int z1,z2;
		if(a!=0) a=0xff;
		for(z1=0;z1<8;z1++)
		{
				setpage(z1);
				setaddr(0);
				for(z2=0;z2<128;z2++)
				{
				LCD_IO_DATA =a;
				senddata();
				}
		}
}





//========================================================
//显示汉字
//========================================================
void putstring(char a,char b,char *n)   //汉字
{
		idata char i,*p;
		printu(n);
		while(*n!=0)
		{
		
				p=q+12*(*n-32);
				setpage(a+1);
				setaddr(b);
				for(i=0;i<6;i++)
				{x(*p);
				p++;}
				setpage(a);
				setaddr(b);
				for(i=6;i<12;i++)
				{x(*p);
				p++;}
				
				
				b = b+7;
				if((b + 7) > 127)
				{
				b = 0;
				if(a < 2 ) break;
				else a -= 2;
				}
				
				n++;
		}

}

void x(char n)
{
		LCD_IO_DATA =n;
		senddata();
}

main2()
{
	idata int i;
	InitGraphic();//putchar(0,62,0);
	//while(1)
	for(i=0;i<100;i++)
	{
		putstring(6,0, "Welcome to http://shop34480016.taobao.com  www.dianshijin.cn");
	}
}

